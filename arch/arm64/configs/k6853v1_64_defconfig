## init/Kconfig
```kconfig
# 注释掉或删除这一行
# source "kernel/sched_assist/Kconfig"

menu "Scheduler features"

config UCLAMP_TASK
	bool "Enable utilization clamping for RT/FAIR tasks"
	depends on CPU_FREQ_GOV_SCHEDUTIL
	default n
	help
	  This feature enables the scheduler to track the clamped utilization
	  of each CPU based on RUNNABLE tasks currently scheduled on that CPU.

source "kernel/sched_assist/Kconfig"

endmenu
```

## kernel/sched_assist/Kconfig
```kconfig
# SPDX-License-Identifier: GPL-2.0
#
# OPLUS scheduler assist configuration
#

config OPLUS_FEATURE_SCHED_ASSIST
	bool "OPLUS scheduler assist"
	default n
	help
	  Enable scheduler assist feature for OPLUS device.
	  Including ui thread scheduling optimization,
	  render thread scheduling optimization and
	  animation optimization.
```
